## third_party/microlink/examples/basic_connect/main/Kconfig.projbuild
```kconfig
menu "Example Configuration"

    config ML_EXAMPLE_TARGET_PEER_IP
        string "Target Peer VPN IP (for sending)"
        default ""
        help
            VPN IP of the peer to send "hello" messages to (e.g., "100.103.181.24").
            Leave empty to only receive (no outgoing messages).
            The peer should run: nc -lu 9000

endmenu
```

## third_party/microlink/examples/basic_connect/sdkconfig.defaults
```kconfig
# MicroLink v2 - ESP32-S3 sdkconfig defaults
# Target
CONFIG_IDF_TARGET="esp32s3"

# PSRAM (required for large buffers)
CONFIG_SPIRAM=y
CONFIG_SPIRAM_MODE_OCT=y
CONFIG_SPIRAM_SPEED_80M=y
CONFIG_SPIRAM_TRY_ALLOCATE_WIFI_LWIP=y

# lwIP (WireGuard needs raw sockets + larger buffers)
CONFIG_LWIP_MAX_SOCKETS=16
CONFIG_LWIP_SO_RCVBUF=y
CONFIG_LWIP_TCPIP_RECVMBOX_SIZE=64
CONFIG_LWIP_TCP_SND_BUF_DEFAULT=32768
CONFIG_LWIP_TCP_WND_DEFAULT=32768

# mbedTLS (Noise protocol needs ChaCha20-Poly1305)
CONFIG_MBEDTLS_CHACHA20_C=y
CONFIG_MBEDTLS_POLY1305_C=y
CONFIG_MBEDTLS_CHACHAPOLY_C=y
CONFIG_MBEDTLS_HKDF_C=y
CONFIG_MBEDTLS_SSL_PROTO_TLS1_2=y

# FreeRTOS
CONFIG_FREERTOS_HZ=1000
CONFIG_FREERTOS_TIMER_TASK_STACK_DEPTH=4096

# WiFi — low-latency tuning for WireGuard traffic
CONFIG_ESP_WIFI_STATIC_RX_BUFFER_NUM=10
CONFIG_ESP_WIFI_DYNAMIC_RX_BUFFER_NUM=32
CONFIG_ESP_WIFI_AMPDU_TX_ENABLED=n
CONFIG_ESP_WIFI_AMPDU_RX_ENABLED=n

# CPU frequency (240MHz for crypto performance)
CONFIG_ESP_DEFAULT_CPU_FREQ_MHZ_240=y

# Watchdog (extended for TLS handshakes)
CONFIG_ESP_TASK_WDT_TIMEOUT_S=30

# Partition table
CONFIG_PARTITION_TABLE_SINGLE_APP_LARGE=y

# Log level
CONFIG_LOG_DEFAULT_LEVEL_INFO=y

# HTTP Config Server (runtime WiFi/auth/peer config via web UI)
CONFIG_ML_ENABLE_CONFIG_HTTPD=y
CONFIG_ML_CONFIG_MAX_ALLOWED_PEERS=512

# Priority peer (guaranteed WG slot even when peer table is full)
CONFIG_ML_PRIORITY_PEER_IP=""
```

## third_party/microlink/examples/cellular_connect/main/Kconfig.projbuild
```kconfig
menu "Cellular Connect Example"

    config ML_EXAMPLE_TARGET_PEER_IP
        string "Target Peer VPN IP (for sending)"
        default ""
        help
            VPN IP of the peer to send "hello" messages to (e.g., "100.103.181.24").
            Leave empty to only receive (no outgoing messages).

    choice ML_EXAMPLE_TRANSPORT
        prompt "Transport protocol"
        default ML_EXAMPLE_UDP
        help
            Choose UDP or TCP for sending data to the target peer.
            UDP: Uses microlink_udp_send (fire-and-forget, low overhead).
            TCP: Uses microlink_tcp_connect/send (reliable, connection-oriented).

        config ML_EXAMPLE_UDP
            bool "UDP"
        config ML_EXAMPLE_TCP
            bool "TCP"
    endchoice

    config ML_EXAMPLE_TCP_PORT
        int "TCP destination port"
        default 5055
        depends on ML_EXAMPLE_TCP
        help
            TCP port on the target peer to connect to.
            Common: 5055 (Traccar OsmAnd), 80 (HTTP), 1883 (MQTT).

endmenu
```

## third_party/microlink/examples/cellular_connect/sdkconfig.defaults
```kconfig
# MicroLink v2 Cellular Connect — ESP32-S3
# Board selection: change via menuconfig (Waveshare SIM7600X or LILYGO T-SIM7670G-S3)
# Target
CONFIG_IDF_TARGET="esp32s3"

# PSRAM
CONFIG_SPIRAM=y
CONFIG_SPIRAM_MODE_OCT=y
CONFIG_SPIRAM_SPEED_80M=y
CONFIG_SPIRAM_TRY_ALLOCATE_WIFI_LWIP=y

# Flash
CONFIG_ESPTOOLPY_FLASHSIZE_8MB=y

# lwIP
CONFIG_LWIP_MAX_SOCKETS=16
CONFIG_LWIP_SO_RCVBUF=y
CONFIG_LWIP_TCPIP_RECVMBOX_SIZE=64
CONFIG_LWIP_TCP_SND_BUF_DEFAULT=32768
CONFIG_LWIP_TCP_WND_DEFAULT=32768
# PPP support
CONFIG_LWIP_PPP_SUPPORT=y
CONFIG_LWIP_PPP_PAP_SUPPORT=y
CONFIG_LWIP_PPP_CHAP_SUPPORT=y
CONFIG_LWIP_PPP_ENABLE_IPV6=n
CONFIG_LWIP_PPP_VJ_HEADER_COMPRESSION=n

# mbedTLS (Noise protocol + TLS)
CONFIG_MBEDTLS_CHACHA20_C=y
CONFIG_MBEDTLS_POLY1305_C=y
CONFIG_MBEDTLS_CHACHAPOLY_C=y
CONFIG_MBEDTLS_HKDF_C=y
CONFIG_MBEDTLS_SSL_PROTO_TLS1_2=y

# FreeRTOS
CONFIG_FREERTOS_HZ=1000
CONFIG_FREERTOS_TIMER_TASK_STACK_DEPTH=4096

# CPU frequency (240MHz for crypto performance)
CONFIG_ESP_DEFAULT_CPU_FREQ_MHZ_240=y

# Main task stack (cellular init + AT commands need more stack)
CONFIG_ESP_MAIN_TASK_STACK_SIZE=8192

# Watchdog (extended for TLS handshakes over cellular)
CONFIG_ESP_TASK_WDT_TIMEOUT_S=60

# Partition table
CONFIG_PARTITION_TABLE_SINGLE_APP_LARGE=y

# Log level
CONFIG_LOG_DEFAULT_LEVEL_INFO=y

# UART — ensure console UART doesn't conflict with modem UART
CONFIG_ESP_CONSOLE_UART_NUM=0

# MicroLink — enable cellular modem (board selected via menuconfig)
CONFIG_ML_ENABLE_CELLULAR=y

# Cellular APN (REQUIRED for PPP — without this, IPCP gets no response)
# Google Fi: h2g2, Soracom: soracom.io, Teal: teal
CONFIG_ML_CELLULAR_APN="america.bics"

# HTTP Config Server (runtime WiFi/auth/peer config via web UI)
CONFIG_ML_ENABLE_CONFIG_HTTPD=y
CONFIG_ML_CONFIG_MAX_ALLOWED_PEERS=512

# Priority peer (guaranteed WG slot even when peer table is full)
CONFIG_ML_PRIORITY_PEER_IP=""
```

## third_party/microlink/examples/cellular_heartbeat/main/Kconfig.projbuild
```kconfig
menu "Cellular Heartbeat Example"

    config ML_EXAMPLE_OPERATOR_PEER_IP
        string "Operator Station VPN IP"
        default ""
        help
            Tailscale VPN IP of the operator station (e.g., "100.114.120.57").
            If set, heartbeats are sent to this peer immediately.
            If empty, heartbeats start after receiving the first message from any peer.

endmenu
```

## third_party/microlink/examples/failover_connect/main/Kconfig.projbuild
```kconfig
menu "Failover Connect Example"

    config ML_EXAMPLE_TARGET_PEER_IP
        string "Target Peer VPN IP (for sending)"
        default ""
        help
            VPN IP of the peer to send messages to (e.g., "100.114.120.57").
            Leave empty to only receive.

    config ML_EXAMPLE_UDP_PORT
        int "UDP port"
        default 9000

endmenu
```
